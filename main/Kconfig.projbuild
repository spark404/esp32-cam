## main/Kconfig.projbuild
```kconfig
menu "Esp32Cam Configuration"

    config ESPCAM_WIFI_SSID
        string "Network ESSID"
        default "ESSID"
        help
            The SSID of the WiFi network to connect to

    config ESPCAM_WIFI_SECRET
        string "Network WPA2 Key"
        default "secret"
        help
            The secret

    config ESPCAM_AWS_IOT_ENDPOINT
        string "Hostname of the IOT endpoint"
        default "localhost"
        help
            Enter the hostname of the device data endpoint from your AWS IoT account

    choice ESP_AWS_CERTS_SOURCE
        prompt "Select certificate source"

    config ESPCAM_AWS_CERTS_EMBEDDED
        bool "Embed certificates in binary"
        help
            Embed the certificates in the certs/ directory in the firmware binary

    config ESPCAM_AWS_CERTS_SD
        bool "Read certificates from SD card"
        help
            Read the certificates from an SD card at runtime

    endchoice

endmenu
```

## sdkconfig.defaults
```kconfig
# ESP32-CAM units have a SPIRAM chip, required for the camera component
CONFIG_ESP32_SPIRAM_SUPPORT=y

# ESP32-CAM units have 4Mb flash
CONFIG_ESPTOOLPY_FLASHSIZE_4MB=y
CONFIG_ESPTOOLPY_FLASHSIZE="4MB"

# Certificates and configuration stored on SD card
CONFIG_ESPCAM_AWS_CERTS_SD=y

# Use SPIRAM where possible, not a lot of memory for all these toys
CONFIG_SPIRAM_TRY_ALLOCATE_WIFI_LWIP=y
CONFIG_MBEDTLS_EXTERNAL_MEM_ALLOC=y
CONFIG_SPIRAM_TRY_ALLOCATE_WIFI_LWIP=y
```
